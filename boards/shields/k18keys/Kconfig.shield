## boards/shields/k18keys/Kconfig.shield
```kconfig
# Copyright (c) 2020 Pete Johanson
# SPDX-License-Identifier: MIT
config SHIELD_K18KEYS_LEFT
    def_bool $(shields_list_contains,k18keys_left)

config SHIELD_K18KEYS_RIGHT
    def_bool $(shields_list_contains,k18keys_right)
```

## boards/shields/k3macropad/Kconfig.shield
```kconfig
# Copyright (c) 2020 Pete Johanson
# SPDX-License-Identifier: MIT

config SHIELD_K3MACROPAD
    def_bool $(shields_list_contains,k3macropad)
```

## boards/shields/k9macropad/Kconfig.shield
```kconfig
# Copyright (c) 2020 Pete Johanson
# SPDX-License-Identifier: MIT

config SHIELD_K9MACROPAD
    def_bool $(shields_list_contains,k9macropad)
```
